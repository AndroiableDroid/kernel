## drivers/platform/test/Kconfig
```kconfig
# LYF configuration options

config TEST_ONLY
	bool "LYF Mobee01a"
	depends on ARCH_MSM8916
	help
	  Support for LYF mobee01a variants
	  make macro CONFIG_TEST_ONLY WORKED

config TESTPLUS_ONLY
	bool "LYF Mobee01a Plus"
	depends on ARCH_MSM8916
	help
	  Support for LYF mobee01a variants
	  make macro CONFIG_TEST_ONLY WORKED

config TBW5770A2_ONLY
	bool "LYF TBW5770A2"
	depends on ARCH_MSM8916
	help
	  Support for LYF TBW5770A2 variants
	  make macro CONFIG_TBW5770A2_ONLY WORKED
```
